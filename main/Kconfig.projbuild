## main/Kconfig.projbuild
```kconfig
menu "SISBARC-COMMON Configuration"
    config APP_WIFI_SSID
        string "WiFi SSID"
        default "Magalhaes"
        help
            SSID (network name) for the example to connect to.

    config APP_WIFI_PASSWORD
        string "WiFi Password"
        default "C@tarin@"
        help
            WiFi password (WPA or WPA2) for the example to use.
            Can be left blank if the network has no security set.

    config APP_CONNECT_IPV6
        bool "Obtain IPv6 link-local address"
        depends on IDF_TARGET_ESP32
        # ToDo: remove once IPV6 is supported on esp32s2
        default y
        help
            By default, examples will wait until IPv4 and IPv6 addresses are obtained.
            Disable this option if the network does not support IPv6.
endmenu
```
